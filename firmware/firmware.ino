/*
  KB2040 multi-board USB composite: CDC-ACM (Serial) + CDC-NCM (Ethernet) + WebSocket Web UI + OTA

  Target : Adafruit KB2040 (FQBN rp2040:rp2040:adafruit_kb2040:flash=8388608_4194304)
           8 MB flash = 4 MB sketch + 4 MB LittleFS (slot config + OTA staging).
  Core   : earlephilhower/arduino-pico, default "Pico SDK" USB stack (Serial and
           NCMEthernetlwIP enumerate together; 1200-baud touch reset stays active).

  Addressing (slot stored in LittleFS /slot.txt, 0 = default/unassigned):
    slot 0    : 192.168.7.1/24    mDNS kb2040.local
    slot 1..4 : 192.168.7N.1/24   mDNS kb2040-N.local (+ alias kb2040.local)
    The built-in DHCP server leases <net>.2.. to the host, with no router and no DNS option.

  HTTP (port 80):
    GET  /                       Web UI
    GET  /ws                     WebSocket (RFC 6455): telemetry push + JSON commands
    GET  /api/state              telemetry JSON
    POST /api/led?state=on|off|toggle   /api/interval?ms=N   /api/slot?slot=N
    POST /api/identify   /api/reboot   /api/cmd (JSON command body)
    GET  /api/firmware.bin       the running image, read straight from XIP flash
    POST /api/update             raw .bin body (optional X-CRC32 header) -> LittleFS -> PicoOTA

  Serial (newline-delimited): JSON commands ({"cmd":...}) or LED:ON|LED:OFF|LED:TOGGLE|STATE|
    IDENTIFY|INTERVAL:<ms>|SLOT:<n>|REBOOT|BOOTSEL|OTA:START:<size>[:<crc32hex>]

  Physical BOOT button held 3 s: forget the slot (back to 192.168.7.1) and reboot.
*/

#include <Arduino.h>
#include <LittleFS.h>
#include <Updater.h>
#include <PicoOTA.h>
#include <Hash.h>
#include <NCMEthernetlwIP.h>
#include <WiFiServer.h>
#include <WiFiClient.h>
#include <Adafruit_NeoPixel.h>
#include <pico/unique_id.h>
#include <USB.h>
#include "app_types.h"
#include "build_info.h"  // generated by compile.sh: forces a rebuild so __DATE__/__TIME__ are fresh
#include "dhcp_server.h"
#include "mdns_responder.h"
#include "webui.h"
#include "webassets.h"  // generated by compile.sh: PWA manifest + icons

extern "C" char __flash_binary_end;  // linker: end of the program image in flash
// _FS_start (linker: start of the LittleFS region = max sketch size) is declared by PicoOTA.h

// ---------------------------------------------------------------- configuration
static constexpr uint16_t kHttpPort = 80;
static constexpr int kMaxWsClients = 3;        // lwIP MEMP_NUM_TCP_PCB = 5: leave 2 for HTTP
static constexpr uint32_t kMinIntervalMs = 50, kMaxIntervalMs = 10000;
static constexpr uint32_t kBootHoldMs = 3000;
static constexpr uint32_t kCollisionGraceMs = 6000;
static constexpr uint32_t kOtaChunk = 4096;     // serial OTA ack granularity
static constexpr uint32_t kOtaIdleTimeoutMs = 10000;
static const char kSlotFile[] = "/slot.txt";
// FW_NCM_TEST (NCM_TEST=1 ./compile.sh): Android test build. USB exposes only the CDC-NCM network
// function (no CDC-ACM serial, so no 1200-baud reset: update it over HTTP or with the BOOT button),
// and the MAC's first byte is 0x00 (universally administered). Normal builds are unaffected.
#if FW_NCM_TEST
static const char kVersion[] = __DATE__ " " __TIME__ " ncm-test";
#else
static const char kVersion[] = __DATE__ " " __TIME__;
#endif

// ---------------------------------------------------------------- identity & state
static uint64_t chipId = 0;
static char chipIdStr[17];
static uint8_t macAddr[6];
static char macStr[18];
static uint8_t boardSlot = 0;
static IPAddress localIp;
static char ipStr[16];
static char hostName[12];  // "kb2040" or "kb2040-N" (without .local)

bool ledState = false;
uint32_t counter = 0;
uint32_t broadcastIntervalMs = 1000;

static bool clientSeen = false;        // any HTTP/WS contact since boot (collision heuristic)
static uint32_t lastTick = 0;
static uint32_t rebootAt = 0;          // 0 = none scheduled
static uint32_t identifyStart = 0;     // 0 = not identifying
static uint32_t bootHoldMs = 0;        // current BOOT button hold time
static bool netAnnounced = false;
static volatile uint32_t rxFrames = 0;  // Ethernet frames received from the host
static uint32_t usbRelinks = 0;         // forced USB re-enumerations (link watchdog)
static netif_input_fn origNetifInput = nullptr;

Adafruit_NeoPixel pixel(1, PIN_NEOPIXEL, NEO_GRB + NEO_KHZ800);
NCMEthernetlwIP eth;
WiFiServer httpServer(kHttpPort);

static IPAddress slotIp(uint8_t slot) {
  return slot == 0 ? IPAddress(192, 168, 7, 1) : IPAddress(192, 168, 70 + slot, 1);
}
static void slotHostName(uint8_t slot, char *out, size_t len) {
  if (slot == 0) snprintf(out, len, "kb2040");
  else snprintf(out, len, "kb2040-%u", slot);
}

// ---------------------------------------------------------------- CRC32 (IEEE, nibble table)
static uint32_t crc32Update(uint32_t crc, const uint8_t *p, size_t n) {
  static const uint32_t t[16] = {
    0x00000000, 0x1DB71064, 0x3B6E20C8, 0x26D930AC, 0x76DC4190, 0x6B6B51F4, 0x4DB26158, 0x5005713C,
    0xEDB88320, 0xF00F9344, 0xD6D6A3E8, 0xCB61B38C, 0x9B64C2B0, 0x86D3D2D4, 0xA00AE278, 0xBDBDF21C};
  crc = ~crc;
  while (n--) {
    crc ^= *p++;
    crc = (crc >> 4) ^ t[crc & 15];
    crc = (crc >> 4) ^ t[crc & 15];
  }
  return ~crc;
}

// ---------------------------------------------------------------- tiny JSON field reader
// Returns the raw value of "key" (string contents without quotes, or a bare token).
static bool jsonGet(const String &j, const char *key, String &out) {
  // Only a key counts: "key" followed by optional whitespace and ':'. (In {"cmd":"slot","slot":1}
  // the first "slot" is a value and must be skipped.)
  String k = String('"') + key + '"';
  int i = -1;
  for (int from = 0;;) {
    int at = j.indexOf(k, from);
    if (at < 0) return false;
    int p = at + k.length();
    while (p < (int)j.length() && (j[p] == ' ' || j[p] == '\t')) p++;
    if (p < (int)j.length() && j[p] == ':') { i = p + 1; break; }
    from = at + 1;
  }
  while (i < (int)j.length() && (j[i] == ' ' || j[i] == '\t')) i++;
  if (i >= (int)j.length()) return false;
  if (j[i] == '"') {
    int e = j.indexOf('"', i + 1);
    if (e < 0) return false;
    out = j.substring(i + 1, e);
  } else {
    int e = i;
    while (e < (int)j.length() && j[e] != ',' && j[e] != '}' && j[e] != ' ') e++;
    out = j.substring(i, e);
  }
  return true;
}

// ---------------------------------------------------------------- WebSocket server
static WsConn ws[kMaxWsClients];

static int wsCount() {
  int n = 0;
  for (auto &w : ws) n += w.active;
  return n;
}

static void wsDrop(WsConn &w) {
  w.c.stop();
  w.active = false;
  w.rxLen = 0;
}

static bool wsSendFrame(WsConn &w, uint8_t opcode, const uint8_t *data, size_t len) {
  if (!w.active) return false;
  uint8_t hdr[4];
  size_t h = 2;
  hdr[0] = 0x80 | opcode;
  if (len < 126) {
    hdr[1] = (uint8_t)len;
  } else {
    hdr[1] = 126;
    hdr[2] = (uint8_t)(len >> 8);
    hdr[3] = (uint8_t)len;
    h = 4;
  }
  if (!w.c.connected() || w.c.availableForWrite() < (int)(h + len)) {
    wsDrop(w);  // gone, or wedged for a long time: the browser reconnects
    return false;
  }
  w.c.write(hdr, h);
  if (len) w.c.write(data, len);
  return true;
}

static void wsSendText(WsConn &w, const String &s) {
  wsSendFrame(w, 0x1, (const uint8_t *)s.c_str(), s.length());
}

static void wsBroadcast(const String &s) {
  for (auto &w : ws)
    if (w.active) wsSendText(w, s);
}

static String base64(const uint8_t *d, size_t n) {
  static const char a[] = "ABCDEFGHIJKLMNOPQRSTUVWXYZabcdefghijklmnopqrstuvwxyz0123456789+/";
  String out;
  for (size_t i = 0; i < n; i += 3) {
    uint32_t v = d[i] << 16 | (i + 1 < n ? d[i + 1] << 8 : 0) | (i + 2 < n ? d[i + 2] : 0);
    out += a[(v >> 18) & 63];
    out += a[(v >> 12) & 63];
    out += i + 1 < n ? a[(v >> 6) & 63] : '=';
    out += i + 2 < n ? a[v & 63] : '=';
  }
  return out;
}

// ---------------------------------------------------------------- state broadcast
static String telemetryJson() {
  char buf[420];
  snprintf(buf, sizeof(buf),
           "{\"type\":\"telemetry\",\"counter\":%lu,\"intervalMs\":%lu,\"led\":%s,\"slot\":%u,"
           "\"ip\":\"%s\",\"hostname\":\"%s.local\",\"chipId\":\"%s\",\"mac\":\"%s\","
           "\"version\":\"%s\",\"uptimeMs\":%lu,\"wsClients\":%d,\"usbRelinks\":%lu}",
           (unsigned long)counter, (unsigned long)broadcastIntervalMs, ledState ? "true" : "false",
           boardSlot, ipStr, hostName, chipIdStr, macStr, kVersion, (unsigned long)millis(), wsCount(),
           (unsigned long)usbRelinks);
  return String(buf);
}

static void broadcastState() {
  String j = telemetryJson();
  wsBroadcast(j);
  Serial.println(j);
}

static void broadcastAll(const String &j) {
  wsBroadcast(j);
  Serial.println(j);
}

static String rebootNotice(const char *reason, uint8_t newSlot) {
  char host[12];
  slotHostName(newSlot, host, sizeof(host));
  String ip = slotIp(newSlot).toString();
  char buf[260];
  snprintf(buf, sizeof(buf),
           "{\"type\":\"reboot\",\"reason\":\"%s\",\"slot\":%u,\"chipId\":\"%s\",\"hostname\":\"%s.local\","
           "\"ip\":\"%s\",\"url\":\"http://%s.local/\",\"ipUrl\":\"http://%s/\"}",
           reason, newSlot, chipIdStr, host, ip.c_str(), host, ip.c_str());
  return String(buf);
}

static void scheduleReboot(uint32_t inMs) {
  rebootAt = millis() + inMs;
  if (rebootAt == 0) rebootAt = 1;
}

// ---------------------------------------------------------------- NeoPixel
static uint32_t shownColor = 0xFFFFFFFF;
static void showColor(uint32_t c) {
  if (c == shownColor) return;
  shownColor = c;
  pixel.setPixelColor(0, c);
  pixel.show();
}
static uint32_t rgb(uint8_t r, uint8_t g, uint8_t b) { return Adafruit_NeoPixel::Color(r, g, b); }

static bool collisionWarning(uint32_t now) {
  return boardSlot == 0 && !clientSeen && !ledState && now > kCollisionGraceMs && eth.isLinked();
}

// Priority: identify > BOOT-button hold > IP-collision warning > normal LED state.
static void serviceLed(uint32_t now) {
  if (identifyStart) {
    int32_t d = (int32_t)(now - identifyStart);
    uint32_t t = d > 0 ? (uint32_t)d : 0;  // signed: a stamp newer than `now` means "just started"
    if (t < 5 * 250) {
      uint32_t k = t / 250;
      bool on = (t % 250) < 130;
      showColor(on ? (k % 2 ? rgb(0, 255, 255) : rgb(255, 255, 255)) : 0);
      return;
    }
    identifyStart = 0;
  }
  if (bootHoldMs >= 300) {
    uint32_t lvl = 20 + 200 * min(bootHoldMs, kBootHoldMs) / kBootHoldMs;
    showColor(rgb(lvl, 0, lvl));
    return;
  }
  if (collisionWarning(now)) {
    uint32_t t = now % 2000;
    uint32_t f = t < 300 ? t : (t < 600 ? 600 - t : 0);  // 0..300 triangle, once per 2 s
    showColor(rgb(255 * f / 300, 100 * f / 300, 0));
    return;
  }
  showColor(ledState ? rgb(0, 150, 50) : 0);
}

static void setLed(bool on) {
  ledState = on;
  serviceLed(millis());
  broadcastState();
}

// ---------------------------------------------------------------- slot persistence
static uint8_t readSlot() {
  File f = LittleFS.open(kSlotFile, "r");
  if (!f) return 0;
  int v = f.readString().toInt();
  f.close();
  return (v >= 1 && v <= 4) ? (uint8_t)v : 0;
}

static bool writeSlot(uint8_t slot) {
  if (slot == 0) return !LittleFS.exists(kSlotFile) || LittleFS.remove(kSlotFile);
  File f = LittleFS.open(kSlotFile, "w");
  if (!f) return false;
  bool ok = f.print(slot) > 0;
  f.close();
  return ok;
}

// ---------------------------------------------------------------- BOOT button: 3 s slot reset
static void factoryResetSlot() {
  Serial.println("{\"type\":\"event\",\"event\":\"slot_reset\",\"source\":\"bootsel\"}");
  broadcastAll(rebootNotice("slot_reset", 0));
  writeSlot(0);
  // Rapid magenta flash, then keep flashing until the button is released: the boot ROM
  // samples BOOTSEL on every reset, so rebooting while it is held would enter RPI-RP2 mode.
  uint32_t start = millis();
  for (int i = 0; i < 8 || (BOOTSEL && millis() - start < 30000); i++) {
    showColor(rgb(255, 0, 255));
    delay(60);
    showColor(0);
    delay(60);
  }
  Serial.flush();
  rp2040.reboot();
}

static void serviceBootButton(uint32_t now) {
  static uint32_t lastPoll = 0, pressStart = 0;
  static bool pressed = false;
  if (now - lastPoll < 50) return;  // reading BOOTSEL briefly stalls flash access: poll at 20 Hz
  lastPoll = now;
  bool b = BOOTSEL;
  if (b && !pressed) {
    pressed = true;
    pressStart = now;
  } else if (!b) {
    pressed = false;
  }
  bootHoldMs = pressed ? now - pressStart : 0;
  if (bootHoldMs >= kBootHoldMs) factoryResetSlot();
}

// ---------------------------------------------------------------- OTA engine (shared by HTTP and Serial)
static OtaSession ota;

static void otaLed() {
  uint32_t lvl = 25 + (uint64_t)230 * ota.received / (ota.total ? ota.total : 1);
  showColor(((ota.received / kOtaChunk) & 1) ? rgb(0, 0, lvl) : rgb(0, lvl / 6, lvl / 2));
}

static void otaReport(const char *phase, bool force) {
  uint32_t now = millis();
  if (!force && now - ota.lastReport < 400) return;
  ota.lastReport = now;
  char buf[200];
  snprintf(buf, sizeof(buf),
           "{\"type\":\"ota\",\"phase\":\"%s\",\"source\":\"%s\",\"received\":%lu,\"total\":%lu,\"chipId\":\"%s\"}",
           phase, ota.source, (unsigned long)ota.received, (unsigned long)ota.total, chipIdStr);
  wsBroadcast(String(buf));  // Serial is the data channel during a serial OTA: WS only
}

static void otaCleanupFiles() {
  LittleFS.remove(_OTA_COMMAND_FILE);
  LittleFS.remove("firmware.bin");
}

static void otaAbort() {
  if (ota.begun && Update.isRunning()) Update.end(false);  // not finished -> discarded, not staged
  otaCleanupFiles();
  ota.active = false;
  ota.begun = false;
  shownColor = 0xFFFFFFFF;
  serviceLed(millis());
}

static bool otaBegin(uint32_t size, const char *source, String &err) {
  uint32_t maxSketch = (uint32_t)&_FS_start - XIP_BASE;
  if (ota.active) { err = "update already in progress"; return false; }
  if (size < 4096) { err = "image too small"; return false; }
  if (size > maxSketch) { err = "image larger than the 4 MB sketch area"; return false; }
  ota = OtaSession();
  ota.active = true;
  ota.total = size;
  ota.source = source;
  ota.startMs = millis();
  otaCleanupFiles();
  otaReport("start", true);
  return true;
}

static bool otaFeed(const uint8_t *d, size_t n, String &err) {
  if (n > ota.total - ota.received) n = ota.total - ota.received;
  ota.crc = crc32Update(ota.crc, d, n);
  size_t consumed = 0;
  if (!ota.begun) {
    size_t take = min(n, sizeof(ota.head) - ota.received);
    memcpy(ota.head + ota.received, d, take);
    ota.received += take;
    consumed = take;
    if (ota.received < sizeof(ota.head)) return true;
    // Same boot2 as the running image = an RP2040 image built for this board's flash chip.
    if (memcmp(ota.head, (const void *)XIP_BASE, sizeof(ota.head)) != 0) {
      err = "not a KB2040/RP2040 image (boot2 block mismatch)";
      return false;
    }
    if (!Update.begin(ota.total)) {
      err = String("Update.begin failed, error ") + Update.getError();
      return false;
    }
    ota.begun = true;
    if (Update.write(ota.head, sizeof(ota.head)) != sizeof(ota.head)) {
      err = String("flash staging write failed, error ") + Update.getError();
      return false;
    }
  }
  if (consumed < n) {
    size_t rest = n - consumed;
    if (Update.write(const_cast<uint8_t *>(d + consumed), rest) != rest) {
      err = String("flash staging write failed, error ") + Update.getError();
      return false;
    }
    ota.received += rest;
  }
  otaLed();
  otaReport("progress", false);
  return true;
}

static bool otaFinish(bool haveCrc, uint32_t expectedCrc, String &err) {
  if (ota.received != ota.total) { err = "incomplete image"; return false; }
  if (haveCrc && expectedCrc != ota.crc) {
    char b[64];
    snprintf(b, sizeof(b), "CRC32 mismatch (expected %08lX, got %08lX)", (unsigned long)expectedCrc,
             (unsigned long)ota.crc);
    err = b;
    return false;
  }
  if (!Update.end()) {
    err = String("Update.end failed, error ") + Update.getError();
    return false;
  }
  ota.begun = false;
  ota.active = false;
  otaReport("done", true);
  showColor(rgb(0, 0, 255));
  return true;
}

static String otaResultJson(bool ok, const String &err) {
  uint32_t ms = millis() - ota.startMs;
  char buf[260];
  if (ok) {
    snprintf(buf, sizeof(buf),
             "{\"type\":\"ota\",\"phase\":\"done\",\"ok\":true,\"size\":%lu,\"crc32\":\"%08lX\",\"ms\":%lu,"
             "\"chipId\":\"%s\",\"rebootInMs\":500}",
             (unsigned long)ota.total, (unsigned long)ota.crc, (unsigned long)ms, chipIdStr);
  } else {
    snprintf(buf, sizeof(buf), "{\"type\":\"ota\",\"phase\":\"error\",\"ok\":false,\"error\":\"%s\",\"received\":%lu}",
             err.c_str(), (unsigned long)ota.received);
  }
  return String(buf);
}

// ---------------------------------------------------------------- command dispatcher
static CmdResult errorResult(int code, const char *cmd, const char *msg) {
  CmdResult r;
  r.code = code;
  r.body = String("{\"type\":\"error\",\"cmd\":\"") + cmd + "\",\"error\":\"" + msg + "\"}";
  return r;
}

static CmdResult runCommand(const String &cmd, const String &arg) {
  CmdResult r;
  if (cmd == "led") {
    String s = arg;
    s.toLowerCase();
    if (s == "on" || s == "true" || s == "1") setLed(true);
    else if (s == "off" || s == "false" || s == "0") setLed(false);
    else if (s == "toggle") setLed(!ledState);
    else return errorResult(400, "led", "state must be on|off|toggle");
    r.body = telemetryJson();
    r.broadcasted = true;
  } else if (cmd == "interval") {
    long ms = arg.toInt();
    if (ms <= 0) return errorResult(400, "interval", "ms must be 50..10000");
    broadcastIntervalMs = constrain((uint32_t)ms, kMinIntervalMs, kMaxIntervalMs);
    lastTick = millis();
    broadcastState();
    r.body = telemetryJson();
    r.broadcasted = true;
  } else if (cmd == "slot") {
    if (arg.length() != 1 || arg[0] < '0' || arg[0] > '4') return errorResult(400, "slot", "slot must be 0..4");
    uint8_t s = arg[0] - '0';
    if (s == boardSlot) {
      r.body = String("{\"type\":\"ack\",\"cmd\":\"slot\",\"ok\":true,\"changed\":false,\"slot\":") + s + "}";
      return r;
    }
    if (!writeSlot(s)) return errorResult(500, "slot", "LittleFS write failed");
    r.body = rebootNotice("slot", s);
    broadcastAll(r.body);
    r.broadcasted = true;
    scheduleReboot(400);
  } else if (cmd == "identify") {
    identifyStart = millis();
    if (!identifyStart) identifyStart = 1;
    r.body = String("{\"type\":\"ack\",\"cmd\":\"identify\",\"ok\":true,\"chipId\":\"") + chipIdStr + "\"}";
  } else if (cmd == "state") {
    r.body = telemetryJson();
  } else if (cmd == "reboot") {
    r.body = rebootNotice("reboot", boardSlot);
    broadcastAll(r.body);
    r.broadcasted = true;
    scheduleReboot(400);
  } else if (cmd == "bootsel") {
    broadcastAll(String("{\"type\":\"reboot\",\"reason\":\"bootsel\",\"chipId\":\"") + chipIdStr + "\"}");
    Serial.flush();
    delay(100);
    rp2040.rebootToBootloader();
  } else {
    return errorResult(400, cmd.c_str(), "unknown command");
  }
  return r;
}

// {"cmd":"led","state":"on"} / {"cmd":"interval","ms":250} / {"cmd":"slot","slot":1} / {"cmd":"identify"}
static CmdResult runJsonCommand(const String &j) {
  String cmd, arg;
  if (!jsonGet(j, "cmd", cmd)) return errorResult(400, "?", "missing cmd");
  if (cmd == "led") jsonGet(j, "state", arg);
  else if (cmd == "interval") jsonGet(j, "ms", arg);
  else if (cmd == "slot") jsonGet(j, "slot", arg);
  return runCommand(cmd, arg);
}

// ---------------------------------------------------------------- WebSocket connection handling
static void wsAccept(WiFiClient &c, const String &key) {
  uint8_t h[20];
  sha1(key + "258EAFA5-E914-47DA-95CA-C5AB0DC85B11", h);
  c.print(F("HTTP/1.1 101 Switching Protocols\r\nUpgrade: websocket\r\nConnection: Upgrade\r\nSec-WebSocket-Accept: "));
  c.print(base64(h, sizeof(h)));
  c.print(F("\r\n\r\n"));
  c.setNoDelay(true);

  int slot = -1;
  for (int i = 0; i < kMaxWsClients; i++)
    if (!ws[i].active) { slot = i; break; }
  if (slot < 0) {  // evict the oldest connection (usually a stale tab)
    slot = 0;
    for (int i = 1; i < kMaxWsClients; i++)
      if (ws[i].since < ws[slot].since) slot = i;
    const uint8_t goingAway[2] = {0x03, 0xE9};  // 1001
    wsSendFrame(ws[slot], 0x8, goingAway, 2);
    wsDrop(ws[slot]);
  }
  ws[slot].c = c;
  ws[slot].active = true;
  ws[slot].since = millis();
  ws[slot].rxLen = 0;
  wsSendText(ws[slot], telemetryJson());
}

static void wsHandleFrame(WsConn &w, uint8_t opcode, uint8_t *payload, size_t len) {
  switch (opcode) {
    case 0x1: {  // text: JSON command
      String msg;
      msg.concat((const char *)payload, len);
      CmdResult r = runJsonCommand(msg);
      if (!r.broadcasted && w.active) wsSendText(w, r.body);
      break;
    }
    case 0x8:  // close: echo and drop
      wsSendFrame(w, 0x8, payload, len >= 2 ? 2 : 0);
      wsDrop(w);
      break;
    case 0x9:  // ping -> pong
      wsSendFrame(w, 0xA, payload, len);
      break;
    default:  // pong / binary / continuation: ignored
      break;
  }
}

static void wsPoll() {
  for (auto &w : ws) {
    if (!w.active) continue;
    if (!w.c.connected() && !w.c.available()) { wsDrop(w); continue; }
    while (w.active && w.c.available() && w.rxLen < sizeof(w.rx)) {
      int n = w.c.read(w.rx + w.rxLen, sizeof(w.rx) - w.rxLen);
      if (n <= 0) break;
      w.rxLen += n;
    }
    // Parse every complete frame in the buffer.
    while (w.active && w.rxLen >= 2) {
      uint8_t b0 = w.rx[0], b1 = w.rx[1];
      size_t plen = b1 & 0x7F, hdr = 2;
      if (plen == 126) {
        if (w.rxLen < 4) break;
        plen = (size_t)w.rx[2] << 8 | w.rx[3];
        hdr = 4;
      } else if (plen == 127 || !(b1 & 0x80)) {  // 64-bit lengths / unmasked client frames: refuse
        wsDrop(w);
        break;
      }
      hdr += 4;  // masking key
      if (hdr + plen > sizeof(w.rx)) { wsDrop(w); break; }  // too large for this tiny server
      if (w.rxLen < hdr + plen) break;
      uint8_t *mask = w.rx + hdr - 4, *p = w.rx + hdr;
      for (size_t i = 0; i < plen; i++) p[i] ^= mask[i & 3];
      wsHandleFrame(w, b0 & 0x0F, p, plen);
      if (!w.active) break;
      size_t used = hdr + plen;
      memmove(w.rx, w.rx + used, w.rxLen - used);
      w.rxLen -= used;
    }
  }
}

// ---------------------------------------------------------------- HTTP
static void sendCommonHeaders(WiFiClient &c) {
  c.print(F("Access-Control-Allow-Origin: *\r\n"
            "Access-Control-Allow-Methods: GET, POST, OPTIONS\r\n"
            "Access-Control-Allow-Headers: Content-Type, X-CRC32\r\n"
            "Access-Control-Expose-Headers: Content-Length, X-CRC32, X-Firmware-Version, X-Chip-Id\r\n"
            "Access-Control-Allow-Private-Network: true\r\n"
            "Access-Control-Max-Age: 600\r\n"));
}

static void writeAll(WiFiClient &c, const uint8_t *p, size_t len) {
  size_t sent = 0;
  uint32_t lastProgress = millis();
  while (sent < len && c.connected()) {
    size_t n = c.write(p + sent, min(len - sent, (size_t)4096));
    if (n) {
      sent += n;
      lastProgress = millis();
    } else if (millis() - lastProgress > 5000) {
      break;
    }
  }
}

static void sendResponse(WiFiClient &c, int code, const char *status, const char *ctype,
                         const uint8_t *body, size_t len) {
  c.printf("HTTP/1.1 %d %s\r\n", code, status);
  sendCommonHeaders(c);
  if (ctype) c.printf("Content-Type: %s\r\n", ctype);
  c.printf("Content-Length: %u\r\nCache-Control: no-store\r\nConnection: close\r\n\r\n", (unsigned)len);
  writeAll(c, body, len);
}

static const char *statusText(int code) {
  switch (code) {
    case 200: return "OK";
    case 400: return "Bad Request";
    case 404: return "Not Found";
    case 409: return "Conflict";
    case 411: return "Length Required";
    case 413: return "Payload Too Large";
    default: return "Internal Server Error";
  }
}

static void sendJson(WiFiClient &c, int code, const String &json) {
  sendResponse(c, code, statusText(code), "application/json", (const uint8_t *)json.c_str(), json.length());
}

static String queryParam(const String &query, const char *key) {
  String k = String(key) + "=";
  int from = 0;
  while (from <= (int)query.length()) {
    int amp = query.indexOf('&', from);
    if (amp < 0) amp = query.length();
    String pair = query.substring(from, amp);
    if (pair.startsWith(k)) return pair.substring(k.length());
    from = amp + 1;
  }
  return String();
}

static void serveFirmware(WiFiClient &c) {
  const uint8_t *img = reinterpret_cast<const uint8_t *>(XIP_BASE);
  size_t len = (uintptr_t)&__flash_binary_end - XIP_BASE;
  uint32_t crc = crc32Update(0, img, len);
  c.print(F("HTTP/1.1 200 OK\r\n"));
  sendCommonHeaders(c);
  c.printf("Content-Type: application/octet-stream\r\nContent-Length: %u\r\n"
           "Content-Disposition: attachment; filename=\"kb2040-%s.bin\"\r\n"
           "X-CRC32: %08lX\r\nX-Firmware-Version: %s\r\nX-Chip-Id: %s\r\n"
           "Cache-Control: no-store\r\nConnection: close\r\n\r\n",
           (unsigned)len, chipIdStr, (unsigned long)crc, kVersion, chipIdStr);
  writeAll(c, img, len);
}

static void handleUpdate(WiFiClient &c, const HttpReq &r) {
  if (r.contentLength <= 0) { sendJson(c, 411, otaResultJson(false, "Content-Length required")); return; }
  String err;
  if (!otaBegin((uint32_t)r.contentLength, "ethernet", err)) {
    sendJson(c, ota.active ? 409 : 413, otaResultJson(false, err));
    return;
  }
  if (r.expectContinue) c.print(F("HTTP/1.1 100 Continue\r\n\r\n"));

  static uint8_t buf[2048];
  uint32_t lastData = millis();
  bool ok = true;
  while (ok && ota.received < ota.total) {
    int avail = c.available();
    if (avail > 0) {
      int n = c.read(buf, min((size_t)avail, sizeof(buf)));
      if (n > 0) {
        ok = otaFeed(buf, n, err);
        lastData = millis();
      }
    } else if (!c.connected()) {
      err = "client disconnected";
      ok = false;
    } else if (millis() - lastData > kOtaIdleTimeoutMs) {
      err = "timeout waiting for data";
      ok = false;
    }
  }
  bool haveCrc = r.crc.length() > 0;
  uint32_t expected = haveCrc ? strtoul(r.crc.c_str(), nullptr, 16) : 0;
  if (ok) ok = otaFinish(haveCrc, expected, err);
  String res = otaResultJson(ok, err);
  if (!ok) {
    otaReport("error", true);
    otaAbort();
    sendJson(c, 400, res);
    return;
  }
  sendJson(c, 200, res);
  broadcastAll(rebootNotice("ota", boardSlot));
  scheduleReboot(500);
}

static const WebAsset *findWebAsset(const String &path) {
  for (const WebAsset &a : WEB_ASSETS)
    if (path == a.path) return &a;
  return nullptr;
}

static void handleHttp() {
  WiFiClient c = httpServer.accept();
  if (!c) return;
  c.setTimeout(300);

  HttpReq r;
  String requestLine = c.readStringUntil('\n');
  for (int i = 0; i < 40; i++) {
    String h = c.readStringUntil('\n');
    if (h.length() <= 1) break;  // "\r" or timeout
    int colon = h.indexOf(':');
    if (colon < 0) continue;
    String name = h.substring(0, colon);
    name.toLowerCase();
    String value = h.substring(colon + 1);
    value.trim();
    if (name == "sec-websocket-key") r.wsKey = value;
    else if (name == "upgrade") { value.toLowerCase(); r.upgrade = value == "websocket"; }
    else if (name == "content-length") r.contentLength = value.toInt();
    else if (name == "x-crc32") r.crc = value;
    else if (name == "expect") { value.toLowerCase(); r.expectContinue = value == "100-continue"; }
  }
  requestLine.trim();
  int sp1 = requestLine.indexOf(' ');
  int sp2 = requestLine.indexOf(' ', sp1 + 1);
  if (sp1 < 0 || sp2 < 0) { c.stop(); return; }
  r.method = requestLine.substring(0, sp1);
  String target = requestLine.substring(sp1 + 1, sp2);
  int q = target.indexOf('?');
  r.path = q >= 0 ? target.substring(0, q) : target;
  r.query = q >= 0 ? target.substring(q + 1) : String();
  clientSeen = true;

  c.setTimeout(3000);
  bool get = r.method == "GET", post = r.method == "POST", getOrPost = get || post;

  if (r.method == "OPTIONS") {
    c.print(F("HTTP/1.1 204 No Content\r\n"));
    sendCommonHeaders(c);
    c.print(F("Content-Length: 0\r\nConnection: close\r\n\r\n"));
  } else if (get && r.path == "/ws" && r.upgrade && r.wsKey.length()) {
    wsAccept(c, r.wsKey);
    return;  // connection stays open
  } else if (get && (r.path == "/" || r.path == "/index.html")) {
    sendResponse(c, 200, "OK", "text/html; charset=utf-8", (const uint8_t *)WEBUI_HTML, WEBUI_HTML_LEN);
  } else if (const WebAsset *asset = get ? findWebAsset(r.path) : nullptr) {
    sendResponse(c, 200, "OK", asset->type, asset->data, asset->len);
  } else if (get && r.path == "/favicon.ico") {
    c.print(F("HTTP/1.1 204 No Content\r\nCache-Control: max-age=86400\r\nContent-Length: 0\r\nConnection: close\r\n\r\n"));
  } else if (get && r.path == "/api/state") {
    sendJson(c, 200, telemetryJson());
  } else if (getOrPost && r.path == "/api/led") {  // GET too, for curl / address-bar use
    CmdResult res = runCommand("led", queryParam(r.query, "state"));
    sendJson(c, res.code, res.body);
  } else if (getOrPost && r.path == "/api/interval") {
    CmdResult res = runCommand("interval", queryParam(r.query, "ms"));
    sendJson(c, res.code, res.body);
  } else if (getOrPost && r.path == "/api/slot") {
    CmdResult res = runCommand("slot", queryParam(r.query, "slot"));
    sendJson(c, res.code, res.body);
  } else if (getOrPost && r.path == "/api/identify") {
    CmdResult res = runCommand("identify", "");
    sendJson(c, res.code, res.body);
  } else if (post && r.path == "/api/reboot") {
    CmdResult res = runCommand("reboot", "");
    sendJson(c, res.code, res.body);
  } else if (post && r.path == "/api/cmd") {
    String body;
    if (r.contentLength > 0 && r.contentLength <= 512) {
      while ((long)body.length() < r.contentLength) {
        int ch = c.read();
        if (ch < 0) {
          if (!c.available() && !c.connected()) break;
          uint32_t t0 = millis();
          while (!c.available() && c.connected() && millis() - t0 < 1000) {}
          if (!c.available()) break;
          continue;
        }
        body += (char)ch;
      }
    }
    CmdResult res = runJsonCommand(body);
    sendJson(c, res.code, res.body);
  } else if (get && r.path == "/api/firmware.bin") {
    serveFirmware(c);
  } else if (post && r.path == "/api/update") {
    handleUpdate(c, r);
  } else {
    sendJson(c, 404, "{\"type\":\"error\",\"error\":\"not_found\"}");
  }
  c.flush();
  c.stop();
}

// ---------------------------------------------------------------- Serial
static void serialOta(uint32_t size, bool haveCrc, uint32_t expectedCrc) {
  String err;
  // Anything already buffered (e.g. a stray '\n' after the command) precedes "ready": discard it.
  delay(20);
  while (Serial.available()) Serial.read();
  if (!otaBegin(size, "serial", err)) {
    Serial.println(otaResultJson(false, err));
    return;
  }
  Serial.printf("{\"type\":\"ota\",\"phase\":\"ready\",\"chunk\":%lu,\"total\":%lu}\n", (unsigned long)kOtaChunk,
                (unsigned long)size);
  static uint8_t buf[512];
  uint32_t lastData = millis(), sinceAck = 0;
  bool ok = true;
  while (ok && ota.received < ota.total) {
    int avail = Serial.available();
    if (avail > 0) {
      size_t want = min((size_t)avail, sizeof(buf));
      want = min(want, (size_t)(ota.total - ota.received));
      size_t n = Serial.readBytes(buf, want);
      if (n) {
        ok = otaFeed(buf, n, err);
        sinceAck += n;
        lastData = millis();
        if (ok && (sinceAck >= kOtaChunk || ota.received == ota.total)) {
          sinceAck = 0;
          Serial.printf("{\"type\":\"ota\",\"phase\":\"ack\",\"received\":%lu}\n", (unsigned long)ota.received);
        }
      }
    } else if (millis() - lastData > kOtaIdleTimeoutMs) {
      err = "timeout waiting for data";
      ok = false;
    }
  }
  if (ok) ok = otaFinish(haveCrc, expectedCrc, err);
  Serial.println(otaResultJson(ok, err));
  if (!ok) {
    otaReport("error", true);
    otaAbort();
    // The host may still be sending the rest of its chunk: drop it instead of parsing binary as commands.
    for (uint32_t t0 = millis(); millis() - t0 < 500;)
      while (Serial.available()) Serial.read();
    return;
  }
  broadcastAll(rebootNotice("ota", boardSlot));
  Serial.flush();
  scheduleReboot(500);
}

static void handleSerialLine(String line) {
  line.trim();
  if (line.length() == 0) return;
  String u = line;
  u.toUpperCase();
  CmdResult r;
  if (line[0] == '{') r = runJsonCommand(line);
  else if (u == "LED:ON") r = runCommand("led", "on");
  else if (u == "LED:OFF") r = runCommand("led", "off");
  else if (u == "LED:TOGGLE") r = runCommand("led", "toggle");
  else if (u == "STATE" || u == "?") r = runCommand("state", "");
  else if (u == "IDENTIFY") r = runCommand("identify", "");
  else if (u == "REBOOT") r = runCommand("reboot", "");
  else if (u == "BOOTSEL") r = runCommand("bootsel", "");
  else if (u.startsWith("INTERVAL:")) r = runCommand("interval", u.substring(9));
  else if (u.startsWith("SLOT:")) r = runCommand("slot", u.substring(5));
  else if (u.startsWith("OTA:START:")) {
    String rest = u.substring(10);
    int colon = rest.indexOf(':');
    uint32_t size = strtoul(rest.c_str(), nullptr, 10);
    bool haveCrc = colon > 0;
    uint32_t crc = haveCrc ? strtoul(rest.c_str() + colon + 1, nullptr, 16) : 0;
    serialOta(size, haveCrc, crc);
    return;
  } else {
    r = errorResult(400, "?", "unknown command");
  }
  // State-changing commands were already printed to Serial by the broadcast.
  if (!r.broadcasted) Serial.println(r.body);
}

static void pollSerial() {
  static char line[192];
  static size_t len = 0;
  static bool overflow = false;
  while (Serial.available() > 0) {
    char ch = (char)Serial.read();
    if (ch == '\n' || ch == '\r') {
      if (!overflow && len > 0) {
        line[len] = '\0';
        len = 0;
        handleSerialLine(String(line));
      }
      len = 0;
      overflow = false;
    } else if (len < sizeof(line) - 1) {
      line[len++] = ch;
    } else {
      overflow = true;  // discard over-long line
    }
  }
}

// ---------------------------------------------------------------- USB link watchdog
// The core's prebuilt TinyUSB NCM driver sends its one-shot "network connected" notification
// only once per USB reset. Occasionally (seen after a quick watchdog reboot) macOS misses it,
// keeps the adapter at "status: inactive" and never starts DHCP. A host with an active link
// always sends something (DHCP, IPv6 RS, mDNS) within a few seconds, so: mounted but not a
// single frame received for 8 s -> force a USB re-enumeration (at most 3 times per boot).
static err_t countingNetifInput(struct pbuf *p, struct netif *n) {
  rxFrames++;
  return origNetifInput(p, n);
}

static void serviceUsbLinkWatchdog(uint32_t now) {
  static uint32_t mountedSince = 0, framesAtMount = 0;
  static bool linkOk = false;
  if (!eth.isLinked()) {
    mountedSince = 0;
    linkOk = false;
    return;
  }
  if (linkOk) return;
  if (!mountedSince) {
    mountedSince = now ? now : 1;
    framesAtMount = rxFrames;
    return;
  }
  if (rxFrames != framesAtMount) {
    linkOk = true;
  } else if (now - mountedSince > 8000 && usbRelinks < 3 && !ota.active) {
    usbRelinks++;
    Serial.printf("{\"type\":\"event\",\"event\":\"usb_relink\",\"count\":%lu}\n", (unsigned long)usbRelinks);
    Serial.flush();
    USB.disconnect();
    delay(500);
    USB.connect();
    mountedSince = 0;
  }
}

// ---------------------------------------------------------------- setup / loop
static void initIdentity() {
  pico_unique_board_id_t id;
  pico_get_unique_board_id(&id);
  chipId = 0;
  for (int i = 0; i < PICO_UNIQUE_BOARD_ID_SIZE_BYTES; i++) chipId = (chipId << 8) | id.id[i];
  snprintf(chipIdStr, sizeof(chipIdStr), "%08lX%08lX", (unsigned long)(chipId >> 32), (unsigned long)chipId);

  // Locally administered, unicast MAC derived from the chip ID (FNV-1a fold), unique per board.
  // The core gives the host side of the NCM link the same MAC with the last byte inverted.
  uint64_t h = 1469598103934665603ULL;
  for (int i = 0; i < 8; i++) {
    h ^= (chipId >> (8 * i)) & 0xFF;
    h *= 1099511628211ULL;
  }
  macAddr[0] = 0x02;
  for (int i = 1; i < 6; i++) macAddr[i] = (h >> (8 * (i - 1))) & 0xFF;
#if FW_NCM_TEST
  macAddr[0] = 0x00;
#endif
  snprintf(macStr, sizeof(macStr), "%02X:%02X:%02X:%02X:%02X:%02X", macAddr[0], macAddr[1], macAddr[2],
           macAddr[3], macAddr[4], macAddr[5]);
}

void setup() {
  pixel.begin();
  pixel.setBrightness(255);
  showColor(0);
#if FW_NCM_TEST
  Serial.end();  // the core starts USB serial before setup(): remove it so only NCM is enumerated
#else
  Serial.begin(115200);
#endif

  initIdentity();

  if (!LittleFS.begin()) Serial.println("{\"type\":\"error\",\"error\":\"littlefs_mount_failed\"}");
  boardSlot = readSlot();
  LittleFS.remove("firmware.bin");  // staged image already applied by the OTA bootloader

  localIp = slotIp(boardSlot);
  snprintf(ipStr, sizeof(ipStr), "%s", localIp.toString().c_str());
  slotHostName(boardSlot, hostName, sizeof(hostName));
  const IPAddress netmask(255, 255, 255, 0);

  // Static address; config() before begin() disables the DHCP client.
  eth.config(localIp, localIp, netmask, localIp);
  eth.setHostname(hostName);
  if (!eth.begin(macAddr)) {
    while (true) {  // NCM failed: keep the UART side alive and blink red
      showColor(rgb(80, 0, 0));
      delay(200);
      showColor(0);
      delay(800);
      Serial.println("{\"type\":\"error\",\"error\":\"ncm_begin_failed\"}");
      pollSerial();
    }
  }

  origNetifInput = eth.getNetIf()->input;
  eth.getNetIf()->input = countingNetifInput;

  ip4_addr_t ip, nm;
  ip4_addr_set_u32(&ip, (uint32_t)localIp);
  ip4_addr_set_u32(&nm, (uint32_t)netmask);
  dhcpServerBegin(eth.getNetIf(), &ip, &nm);

  // Unique name first; assigned boards also answer the default "kb2040.local" alias so a
  // single board with a forgotten slot is still reachable by the default name.
  const char *names[2] = {hostName, "kb2040"};
  if (!mdnsBegin(eth.getNetIf(), &ip, names, boardSlot ? 2 : 1))
    Serial.println("{\"type\":\"error\",\"error\":\"mdns_begin_failed\"}");

  httpServer.begin();
  lastTick = millis();
}

void loop() {
  pollSerial();
  handleHttp();
  wsPoll();
  // Read the clock *after* the handlers: commands stamp identifyStart / lastTick with millis(),
  // and an older `now` would make (now - stamp) wrap around to a huge unsigned value.
  uint32_t now = millis();
  serviceBootButton(now);
  serviceLed(now);
  serviceUsbLinkWatchdog(now);

  if (now - lastTick >= broadcastIntervalMs) {
    lastTick += broadcastIntervalMs;
    if (now - lastTick >= broadcastIntervalMs) lastTick = now;  // don't burst after a long stall
    counter++;
    broadcastState();
  }

  if (rebootAt && (int32_t)(now - rebootAt) >= 0) {
    Serial.flush();
    for (auto &w : ws) {
      const uint8_t restarting[2] = {0x03, 0xF4};  // 1012 Service Restart
      wsSendFrame(w, 0x8, restarting, 2);
      wsDrop(w);
    }
    delay(50);
    rp2040.reboot();
  }

  // One-off info line once the host has configured the USB network function.
  bool linked = eth.isLinked();
  if (linked && !netAnnounced && Serial) {
    Serial.printf("{\"type\":\"event\",\"event\":\"net_up\",\"ip\":\"%s\",\"url\":\"http://%s/\","
                  "\"mdns\":\"http://%s.local/\",\"slot\":%u,\"chipId\":\"%s\"}\n",
                  ipStr, ipStr, hostName, boardSlot, chipIdStr);
    netAnnounced = true;
  } else if (!linked) {
    netAnnounced = false;
  }
}
